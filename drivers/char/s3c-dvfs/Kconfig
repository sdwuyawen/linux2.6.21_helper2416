## drivers/char/s3c-dvfs/Kconfig
```kconfig
#
# DVFS (Dynamic voltage/frequency Scaling)
#

menu "DVFS support"

config DVFS
	tristate "Support for DVFS on SMDK Board"
	depends on CPU_S3C6400 || CPU_S3C6410 || CPU_S3C2416 || CPU_S3C2450 || CPU_S3C2443
endmenu
```

## drivers/l3/Kconfig
```kconfig
#
# L3 bus configuration
#

menu "L3 support"

config L3
	tristate "L3 support"

config L3_ALGOBIT
	boolean "L3 bit-banging interfaces"
	depends on L3

config L3_BIT_SA1100_GPIO
	boolean "SA11x0 GPIO adapter"
	depends on L3_ALGOBIT && ARCH_SA1100
	
# i2c must come before this
config BIT_SA1100_GPIO
	boolean
	depends on L3_BIT_SA1100_GPIO || I2C_BIT_SA1100_GPIO=y
	default y

config L3_BIT_S3C_GPIO
	boolean "S3C GPIO adapter"
	depends on L3_ALGOBIT && ARCH_S3C2410
	
endmenu
```

## drivers/pwm/Kconfig
```kconfig
#
# PWM Timer configuration
#

menu "Pulse Width Modulation Timer"

config PWM
	tristate "Pulse Width Modulation (PWM) Timer support"

config S3C2443_PWM
         bool "S3C2443 PWM support"
         depends on CPU_S3C2443 && PWM
         help
            S3C2443 PWM support.

config S3C2450_PWM
         bool "S3C2450 PWM support"
         depends on CPU_S3C2450 && PWM
         help
            S3C2450 PWM support.

config S3C2416_PWM
         bool "S3C2416 PWM support"
         depends on CPU_S3C2416 && PWM
         help
            S3C2416 PWM support.

config S3C6400_PWM
         bool "S3C6400/10 PWM support"
         depends on (CPU_S3C6400 || CPU_S3C6410) && PWM
         help
           S3C6400 PWM support.
endmenu
```
